## main/Kconfig.projbuild
```kconfig
menu "x-osc-2 Configuration"

    menu "SoftAP Configuration"
        comment "SoftAP Configuration"

        config ESP_WIFI_AP_SSID
            string "WiFi AP SSID"
            default "x-osc-2"
            help
                SSID (network name) of the AP for the example to connect to.

        config ESP_WIFI_AP_PASSWORD
            string "WiFi AP Password"
            default "mypassword"
            help
                WiFi password of the AP for the example to use.

        config ESP_WIFI_AP_CHANNEL
            int "WiFi AP Channel"
            range 1 14
            default 1
            help
                WiFi channel (network channel) of the AP for the example to use.

        config ESP_MAX_STA_CONN_AP
            int "Maximal STA connections"
            default 4
            help
                Max number of the STA connects to AP.
    endmenu

    menu "STA Configuration"
        comment "STA Configuration"

        config ESP_WIFI_REMOTE_AP_SSID
            string "WiFi Remote AP SSID"
            default "otherapssid"
            help
                SSID (network name) for the example's sta to connect to.

        config ESP_WIFI_REMOTE_AP_PASSWORD
            string "WiFi Remote AP Password"
            default "otherappassword"
            help
                WiFi password for the example to use.

        config ESP_MAXIMUM_STA_RETRY
            int "Maximum retry"
            default 5
            help
                Set the maximum retry value to prevent the station from continuously
                attempting to reconnect to the Access Point (AP) when the AP doesn't exist.

        choice ESP_WIFI_SCAN_AUTH_MODE_THRESHOLD
            prompt "WiFi Scan auth mode threshold"
            default ESP_WIFI_AUTH_WPA2_PSK
            help
                The weakest authmode to accept in the scan mode.
                This value defaults to ESP_WIFI_AUTH_WPA2_PSK in case password is present
                and ESP_WIFI_AUTH_OPEN is used. Please select ESP_WIFI_AUTH_WEP / ESP_WIFI_AUTH_WPA_PSK
                in case AP is operating in WEP / WPA mode.

            config ESP_WIFI_AUTH_OPEN
                bool "OPEN"
            config ESP_WIFI_AUTH_WEP
                bool "WEP"
            config ESP_WIFI_AUTH_WPA_PSK
                bool "WPA PSK"
            config ESP_WIFI_AUTH_WPA2_PSK
                bool "WPA2 PSK"
            config ESP_WIFI_AUTH_WPA_WPA2_PSK
                bool "WPA/WPA2 PSK"
            config ESP_WIFI_AUTH_WPA3_PSK
                bool "WPA3 PSK"
            config ESP_WIFI_AUTH_WPA2_WPA3_PSK
                bool "WPA2/WPA3 PSK"
            config ESP_WIFI_AUTH_WAPI_PSK
                bool "WAPI PSK"
        endchoice

    endmenu
    menu "OSC Defaults"
        config  ESP_OSC_REMOTE_IP
            string  "OSC remote IP"
            default "192.168.4.2"
            help 
                Sets the Default load value for the X-OSC-2 on full reset/First time boot
        
        config  ESP_OSC_REMOTE_PORT
            int "Remote Port"
            range 1000  40000
            default  3333
            help
                Sets the Default load value for the X-OSC-2 on full reset/First time boot
        
        config  ESP_OSC_LOCAL_IP
            string  "OSC local IP"
            default "192.168.4.2"
            help 
                Sets the Default load value for the X-OSC-2 on full reset/First time boot
        
        config  ESP_OSC_LOCAL_PORT
            int "local Port"
            range 1000  40000
            default  3333
            help
                Sets the Default load value for the X-OSC-2 on full reset/First time boot
    endmenu
    menu "UDP Config"
        config ESP_GTK_REKEYING_ENABLE
            bool "Enable GTK Rekeying"
            default y
            help
                Flag to enable GTK rekeying.

        config ESP_GTK_REKEY_INTERVAL
            int "GTK rekey interval"
            depends on ESP_GTK_REKEYING_ENABLE
            range 60 65535
            default 600
            help
                GTK rekeying interval in seconds.

        config EXAMPLE_IPV4
            bool "IPV4"
            default y

        config EXAMPLE_IPV6
            bool "IPV6"
            default n
            select EXAMPLE_CONNECT_IPV6

        config EXAMPLE_PORT
            int "Port"
            range 0 65535
            default 3333
            help
                Local port the example server will listen on.


    endmenu
    menu "Board Information"
        config PINCOUNT
            int "Pincount"
            default 28
            help
                Sets number of available GPIO pins
    endmenu
    menu "Firmware Version"
        config  FIRMWARE_VERSION
            string  "Current Firmware Version"
            default "0.0.1"
            help 
                Sets the current firmware version the app responds with
    endmenu
endmenu
```
